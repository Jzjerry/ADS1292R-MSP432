/**
 * @cliArgs --board "/ti/boards/MSP_EXP432P401R" --product "simplelink_msp432p4_sdk@3.40.01.02"
 * @versions {"data":"2020052512","timestamp":"2020052512","tool":"1.5.0+1397","templates":"2020052512"}
 */

/**
 * Import the modules used in this configuration.
 */
const Display  = scripting.addModule("/ti/display/Display", {}, false);
const Display1 = Display.addInstance();
const ADC      = scripting.addModule("/ti/drivers/ADC", {}, false);
const ADC1     = ADC.addInstance();
const GPIO     = scripting.addModule("/ti/drivers/GPIO");
const GPIO1    = GPIO.addInstance();
const GPIO2    = GPIO.addInstance();
const GPIO3    = GPIO.addInstance();
const GPIO4    = GPIO.addInstance();
const I2C      = scripting.addModule("/ti/drivers/I2C", {}, false);
const I2C1     = I2C.addInstance();
const RTOS     = scripting.addModule("/ti/drivers/RTOS");
const SPI      = scripting.addModule("/ti/drivers/SPI", {}, false);
const SPI1     = SPI.addInstance();
const SPI2     = SPI.addInstance();
const Timer    = scripting.addModule("/ti/drivers/Timer", {}, false);
const Timer1   = Timer.addInstance();
const UART     = scripting.addModule("/ti/drivers/UART", {}, false);
const UART1    = UART.addInstance();

/**
 * Write custom configuration values to the imported modules.
 */
Display1.$name                  = "CONFIG_Display_0";
Display1.$hardware              = system.deviceData.board.components.XDS110UART;
Display1.uart.$name             = "CONFIG_UART_0";
Display1.uart.interruptPriority = "6";

ADC1.$name              = "CONFIG_ADC_0";
ADC1.referenceVoltage   = "2.5V";
ADC1.resolution         = "12 Bits";
ADC1.adc.$assign        = "ADC14";
ADC1.adc.adcPin.$assign = "boosterpack.24";

GPIO1.$hardware          = system.deviceData.board.components.LED1_RED;
GPIO1.$name              = "CONFIG_GPIO_LED_0";
GPIO1.initialOutputState = "High";
GPIO1.gpioPin.$assign    = "P1.0.GPIO/EUSCI_A0_SPI.STE";

GPIO2.$name              = "CONFIG_ADS1292_CS";
GPIO2.mode               = "Output";
GPIO2.initialOutputState = "High";
GPIO2.gpioPin.$assign    = "boosterpack.34";

GPIO3.$name            = "CONFIG_ADS1292_RDY";
GPIO3.pull             = "Pull Up";
GPIO3.interruptTrigger = "Falling Edge";
GPIO3.gpioPin.$assign  = "boosterpack.38";

GPIO4.$name = "CONFIG_GPIO_LCD_DC";
GPIO4.mode  = "Output";

I2C1.$name              = "CONFIG_I2C_LMT70";
I2C1.i2c.$assign        = "EUSCI_B1";
I2C1.i2c.sdaPin.$assign = "boosterpack.10";
I2C1.i2c.sclPin.$assign = "boosterpack.9";

const Power                   = scripting.addModule("/ti/drivers/Power", {}, false);
Power.performanceLevel3.$name = "ti_drivers_power_PowerMSP432PerfLevels0";
Power.performanceLevel2.$name = "ti_drivers_power_PowerMSP432PerfLevels1";
Power.performanceLevel1.$name = "ti_drivers_power_PowerMSP432PerfLevels2";
Power.performanceLevel0.$name = "ti_drivers_power_PowerMSP432PerfLevels3";


SPI1.$name                          = "CONFIG_SPI_0";
SPI1.spi.$assign                    = "EUSCI_B0";
SPI1.spi.sclkPin.$assign            = "boosterpack.7";
SPI1.spi.misoPin.$assign            = "boosterpack.14";
SPI1.spi.mosiPin.$assign            = "boosterpack.15";
SPI1.spi.dmaRxChannel.$assign       = "DMA_CH1";
SPI1.spi.dmaTxChannel.$assign       = "DMA_CH2";
SPI1.spi.dmaInterruptNumber.$assign = "DMA_INT0";

SPI2.$name = "CONFIG_SPI_LCD";
SPI2.mode  = "Four Pin SS Active High";

Timer1.$name         = "CONFIG_TIMER_PACE";
Timer1.timer.$assign = "Timer_A1";

UART1.$name         = "CONFIG_UART_HMI";
UART1.dataDirection = "Send Only";

/**
 * Pinmux solution for unlocked pins/peripherals. This ensures that minor changes to the automatic solver in a future
 * version of the tool will not impact the pinmux you originally saw.  These lines can be completely deleted in order to
 * re-solve from scratch.
 */
Display1.uart.uart.$suggestSolution          = "EUSCI_A0";
Display1.uart.uart.txPin.$suggestSolution    = "P1.3.GPIO/EUSCI_A0_UART.TXD/EUSCI_A0_SPI.SIMO";
Display1.uart.uart.rxPin.$suggestSolution    = "P1.2.GPIO/EUSCI_A0_UART.RXD/EUSCI_A0_SPI.SOMI";
GPIO4.gpioPin.$suggestSolution               = "expansion.28";
RTOS.timer0.resource.$suggestSolution        = "Timer_A0";
SPI2.spi.$suggestSolution                    = "EUSCI_B2";
SPI2.spi.sclkPin.$suggestSolution            = "expansion.26";
SPI2.spi.misoPin.$suggestSolution            = "expansion.25";
SPI2.spi.mosiPin.$suggestSolution            = "expansion.23";
SPI2.spi.ssPin.$suggestSolution              = "expansion.24";
SPI2.spi.dmaRxChannel.$suggestSolution       = "DMA_CH7";
SPI2.spi.dmaTxChannel.$suggestSolution       = "DMA_CH6";
SPI2.spi.dmaInterruptNumber.$suggestSolution = "DMA_INT3";
UART1.uart.$suggestSolution                  = "EUSCI_A1";
UART1.uart.txPin.$suggestSolution            = "boosterpack.32";
